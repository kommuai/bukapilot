VERSION ""

NS_ :

BS_:

BU_: RADAR

BO_ 640 RADAR_TRACK_00: 64 RADAR
 SG_ COUNTER12_1 : 0|12@1+ (1,0) [0|65535] "" XXX
 SG_ TRACK_ID : 16|8@1+ (1,0) [0|255] "" XXX
 SG_ LEAD_VALID_COUNTER : 39|24@0+ (1,0) [0|16777215] "" XXX
 SG_ LONG_DIST_ALT : 71|16@0+ (0.001,0) [0|65535] "m" XXX
 SG_ LAT_DIST_ALT : 80|15@0- (0.01,0) [0|32767] "m" XXX
 SG_ VALID_COUNTER : 159|11@0+ (1,0) [0|2047] "" XXX
 SG_ UNKNOWN : 164|16@0- (1,0) [0|65535] "" XXX
 SG_ LONG_DIST : 194|16@0+ (0.001,0) [0|65535] "m" XXX
 SG_ LAT_DIST : 210|15@0- (0.01,0) [0|32767] "m" XXX
 SG_ COUNTER12_2 : 256|12@1+ (1,0) [0|65535] "" XXX
 SG_ CONFIDENCE : 273|25@0+ (2.98023233e-8,0) [0|33554431] "" XXX
 SG_ ALEAD : 365|13@0- (0.01,0) [0|8191] "ms-2" XXX
 SG_ VLEAD : 368|15@0- (0.01,0) [0|32767] "ms-1" XXX
 SG_ LAT_RELATED : 413|15@0- (0.01,0) [0|32767] "" XXX

BO_ 641 RADAR_TRACK_01: 64 RADAR
 SG_ COUNTER12_1 : 0|12@1+ (1,0) [0|65535] "" XXX
 SG_ TRACK_ID : 16|8@1+ (1,0) [0|255] "" XXX
 SG_ LEAD_VALID_COUNTER : 39|24@0+ (1,0) [0|16777215] "" XXX
 SG_ LONG_DIST_ALT : 71|16@0+ (0.001,0) [0|65535] "m" XXX
 SG_ LAT_DIST_ALT : 80|15@0- (0.01,0) [0|32767] "m" XXX
 SG_ VALID_COUNTER : 159|11@0+ (1,0) [0|2047] "" XXX
 SG_ UNKNOWN : 164|16@0- (1,0) [0|65535] "" XXX
 SG_ LONG_DIST : 194|16@0+ (0.001,0) [0|65535] "m" XXX
 SG_ LAT_DIST : 210|15@0- (0.01,0) [0|32767] "m" XXX
 SG_ COUNTER12_2 : 256|12@1+ (1,0) [0|65535] "" XXX
 SG_ CONFIDENCE : 273|25@0+ (2.98023233e-8,0) [0|33554431] "" XXX
 SG_ ALEAD : 365|13@0- (0.01,0) [0|8191] "ms-2" XXX
 SG_ VLEAD : 368|15@0- (0.01,0) [0|32767] "ms-1" XXX
 SG_ LAT_RELATED : 413|15@0- (0.01,0) [0|32767] "" XXX

BO_ 642 RADAR_TRACK_02: 64 RADAR
 SG_ COUNTER12_1 : 0|12@1+ (1,0) [0|65535] "" XXX
 SG_ TRACK_ID : 16|8@1+ (1,0) [0|255] "" XXX
 SG_ LEAD_VALID_COUNTER : 39|24@0+ (1,0) [0|16777215] "" XXX
 SG_ LONG_DIST_ALT : 71|16@0+ (0.001,0) [0|65535] "m" XXX
 SG_ LAT_DIST_ALT : 80|15@0- (0.01,0) [0|32767] "m" XXX
 SG_ VALID_COUNTER : 159|11@0+ (1,0) [0|2047] "" XXX
 SG_ UNKNOWN : 164|16@0- (1,0) [0|65535] "" XXX
 SG_ LONG_DIST : 194|16@0+ (0.001,0) [0|65535] "m" XXX
 SG_ LAT_DIST : 210|15@0- (0.01,0) [0|32767] "m" XXX
 SG_ COUNTER12_2 : 256|12@1+ (1,0) [0|65535] "" XXX
 SG_ CONFIDENCE : 273|25@0+ (2.98023233e-8,0) [0|33554431] "" XXX
 SG_ ALEAD : 365|13@0- (0.01,0) [0|8191] "ms-2" XXX
 SG_ VLEAD : 368|15@0- (0.01,0) [0|32767] "ms-1" XXX
 SG_ LAT_RELATED : 413|15@0- (0.01,0) [0|32767] "" XXX

BO_ 643 RADAR_TRACK_03: 64 RADAR
 SG_ COUNTER12_1 : 0|12@1+ (1,0) [0|65535] "" XXX
 SG_ TRACK_ID : 16|8@1+ (1,0) [0|255] "" XXX
 SG_ LEAD_VALID_COUNTER : 39|24@0+ (1,0) [0|16777215] "" XXX
 SG_ LONG_DIST_ALT : 71|16@0+ (0.001,0) [0|65535] "m" XXX
 SG_ LAT_DIST_ALT : 80|15@0- (0.01,0) [0|32767] "m" XXX
 SG_ VALID_COUNTER : 159|11@0+ (1,0) [0|2047] "" XXX
 SG_ UNKNOWN : 164|16@0- (1,0) [0|65535] "" XXX
 SG_ LONG_DIST : 194|16@0+ (0.001,0) [0|65535] "m" XXX
 SG_ LAT_DIST : 210|15@0- (0.01,0) [0|32767] "m" XXX
 SG_ COUNTER12_2 : 256|12@1+ (1,0) [0|65535] "" XXX
 SG_ CONFIDENCE : 273|25@0+ (2.98023233e-8,0) [0|33554431] "" XXX
 SG_ ALEAD : 365|13@0- (0.01,0) [0|8191] "ms-2" XXX
 SG_ VLEAD : 368|15@0- (0.01,0) [0|32767] "ms-1" XXX
 SG_ LAT_RELATED : 413|15@0- (0.01,0) [0|32767] "" XXX

BO_ 644 RADAR_TRACK_04: 64 RADAR
 SG_ COUNTER12_1 : 0|12@1+ (1,0) [0|65535] "" XXX
 SG_ TRACK_ID : 16|8@1+ (1,0) [0|255] "" XXX
 SG_ LEAD_VALID_COUNTER : 39|24@0+ (1,0) [0|16777215] "" XXX
 SG_ LONG_DIST_ALT : 71|16@0+ (0.001,0) [0|65535] "m" XXX
 SG_ LAT_DIST_ALT : 80|15@0- (0.01,0) [0|32767] "m" XXX
 SG_ VALID_COUNTER : 159|11@0+ (1,0) [0|2047] "" XXX
 SG_ UNKNOWN : 164|16@0- (1,0) [0|65535] "" XXX
 SG_ LONG_DIST : 194|16@0+ (0.001,0) [0|65535] "m" XXX
 SG_ LAT_DIST : 210|15@0- (0.01,0) [0|32767] "m" XXX
 SG_ COUNTER12_2 : 256|12@1+ (1,0) [0|65535] "" XXX
 SG_ CONFIDENCE : 273|25@0+ (2.98023233e-8,0) [0|33554431] "" XXX
 SG_ ALEAD : 365|13@0- (0.01,0) [0|8191] "ms-2" XXX
 SG_ VLEAD : 368|15@0- (0.01,0) [0|32767] "ms-1" XXX
 SG_ LAT_RELATED : 413|15@0- (0.01,0) [0|32767] "" XXX

BO_ 645 RADAR_TRACK_05: 64 RADAR
 SG_ COUNTER12_1 : 0|12@1+ (1,0) [0|65535] "" XXX
 SG_ TRACK_ID : 16|8@1+ (1,0) [0|255] "" XXX
 SG_ LEAD_VALID_COUNTER : 39|24@0+ (1,0) [0|16777215] "" XXX
 SG_ LONG_DIST_ALT : 71|16@0+ (0.001,0) [0|65535] "m" XXX
 SG_ LAT_DIST_ALT : 80|15@0- (0.01,0) [0|32767] "m" XXX
 SG_ VALID_COUNTER : 159|11@0+ (1,0) [0|2047] "" XXX
 SG_ UNKNOWN : 164|16@0- (1,0) [0|65535] "" XXX
 SG_ LONG_DIST : 194|16@0+ (0.001,0) [0|65535] "m" XXX
 SG_ LAT_DIST : 210|15@0- (0.01,0) [0|32767] "m" XXX
 SG_ COUNTER12_2 : 256|12@1+ (1,0) [0|65535] "" XXX
 SG_ CONFIDENCE : 273|25@0+ (2.98023233e-8,0) [0|33554431] "" XXX
 SG_ ALEAD : 365|13@0- (0.01,0) [0|8191] "ms-2" XXX
 SG_ VLEAD : 368|15@0- (0.01,0) [0|32767] "ms-1" XXX
 SG_ LAT_RELATED : 413|15@0- (0.01,0) [0|32767] "" XXX

BO_ 646 RADAR_TRACK_06: 64 RADAR
 SG_ COUNTER12_1 : 0|12@1+ (1,0) [0|65535] "" XXX
 SG_ TRACK_ID : 16|8@1+ (1,0) [0|255] "" XXX
 SG_ LEAD_VALID_COUNTER : 39|24@0+ (1,0) [0|16777215] "" XXX
 SG_ LONG_DIST_ALT : 71|16@0+ (0.001,0) [0|65535] "m" XXX
 SG_ LAT_DIST_ALT : 80|15@0- (0.01,0) [0|32767] "m" XXX
 SG_ VALID_COUNTER : 159|11@0+ (1,0) [0|2047] "" XXX
 SG_ UNKNOWN : 164|16@0- (1,0) [0|65535] "" XXX
 SG_ LONG_DIST : 194|16@0+ (0.001,0) [0|65535] "m" XXX
 SG_ LAT_DIST : 210|15@0- (0.01,0) [0|32767] "m" XXX
 SG_ COUNTER12_2 : 256|12@1+ (1,0) [0|65535] "" XXX
 SG_ CONFIDENCE : 273|25@0+ (2.98023233e-8,0) [0|33554431] "" XXX
 SG_ ALEAD : 365|13@0- (0.01,0) [0|8191] "ms-2" XXX
 SG_ VLEAD : 368|15@0- (0.01,0) [0|32767] "ms-1" XXX
 SG_ LAT_RELATED : 413|15@0- (0.01,0) [0|32767] "" XXX

BO_ 647 RADAR_TRACK_07: 64 RADAR
 SG_ COUNTER12_1 : 0|12@1+ (1,0) [0|65535] "" XXX
 SG_ TRACK_ID : 16|8@1+ (1,0) [0|255] "" XXX
 SG_ LEAD_VALID_COUNTER : 39|24@0+ (1,0) [0|16777215] "" XXX
 SG_ LONG_DIST_ALT : 71|16@0+ (0.001,0) [0|65535] "m" XXX
 SG_ LAT_DIST_ALT : 80|15@0- (0.01,0) [0|32767] "m" XXX
 SG_ VALID_COUNTER : 159|11@0+ (1,0) [0|2047] "" XXX
 SG_ UNKNOWN : 164|16@0- (1,0) [0|65535] "" XXX
 SG_ LONG_DIST : 194|16@0+ (0.001,0) [0|65535] "m" XXX
 SG_ LAT_DIST : 210|15@0- (0.01,0) [0|32767] "m" XXX
 SG_ COUNTER12_2 : 256|12@1+ (1,0) [0|65535] "" XXX
 SG_ CONFIDENCE : 273|25@0+ (2.98023233e-8,0) [0|33554431] "" XXX
 SG_ ALEAD : 365|13@0- (0.01,0) [0|8191] "ms-2" XXX
 SG_ VLEAD : 368|15@0- (0.01,0) [0|32767] "ms-1" XXX
 SG_ LAT_RELATED : 413|15@0- (0.01,0) [0|32767] "" XXX

BO_ 648 RADAR_TRACK_08: 64 RADAR
 SG_ COUNTER12_1 : 0|12@1+ (1,0) [0|65535] "" XXX
 SG_ TRACK_ID : 16|8@1+ (1,0) [0|255] "" XXX
 SG_ LEAD_VALID_COUNTER : 39|24@0+ (1,0) [0|16777215] "" XXX
 SG_ LONG_DIST_ALT : 71|16@0+ (0.001,0) [0|65535] "m" XXX
 SG_ LAT_DIST_ALT : 80|15@0- (0.01,0) [0|32767] "m" XXX
 SG_ VALID_COUNTER : 159|11@0+ (1,0) [0|2047] "" XXX
 SG_ UNKNOWN : 164|16@0- (1,0) [0|65535] "" XXX
 SG_ LONG_DIST : 194|16@0+ (0.001,0) [0|65535] "m" XXX
 SG_ LAT_DIST : 210|15@0- (0.01,0) [0|32767] "m" XXX
 SG_ COUNTER12_2 : 256|12@1+ (1,0) [0|65535] "" XXX
 SG_ CONFIDENCE : 273|25@0+ (2.98023233e-8,0) [0|33554431] "" XXX
 SG_ ALEAD : 365|13@0- (0.01,0) [0|8191] "ms-2" XXX
 SG_ VLEAD : 368|15@0- (0.01,0) [0|32767] "ms-1" XXX
 SG_ LAT_RELATED : 413|15@0- (0.01,0) [0|32767] "" XXX

BO_ 649 RADAR_TRACK_09: 64 RADAR
 SG_ COUNTER12_1 : 0|12@1+ (1,0) [0|65535] "" XXX
 SG_ TRACK_ID : 16|8@1+ (1,0) [0|255] "" XXX
 SG_ LEAD_VALID_COUNTER : 39|24@0+ (1,0) [0|16777215] "" XXX
 SG_ LONG_DIST_ALT : 71|16@0+ (0.001,0) [0|65535] "m" XXX
 SG_ LAT_DIST_ALT : 80|15@0- (0.01,0) [0|32767] "m" XXX
 SG_ VALID_COUNTER : 159|11@0+ (1,0) [0|2047] "" XXX
 SG_ UNKNOWN : 164|16@0- (1,0) [0|65535] "" XXX
 SG_ LONG_DIST : 194|16@0+ (0.001,0) [0|65535] "m" XXX
 SG_ LAT_DIST : 210|15@0- (0.01,0) [0|32767] "m" XXX
 SG_ COUNTER12_2 : 256|12@1+ (1,0) [0|65535] "" XXX
 SG_ CONFIDENCE : 273|25@0+ (2.98023233e-8,0) [0|33554431] "" XXX
 SG_ ALEAD : 365|13@0- (0.01,0) [0|8191] "ms-2" XXX
 SG_ VLEAD : 368|15@0- (0.01,0) [0|32767] "ms-1" XXX
 SG_ LAT_RELATED : 413|15@0- (0.01,0) [0|32767] "" XXX

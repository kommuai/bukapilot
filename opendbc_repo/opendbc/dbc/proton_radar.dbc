CM_ "AUTOGENERATED FILE, DO NOT EDIT";
CM_ "Proton X50 Pre-FL front radar on bus 1: A bank 0x20-0x47, B bank 0x50-0x77";
VERSION ""

NS_ :

BS_:

BU_: XXX

BO_ 32 RADAR_TRACK_20_A: 8 RADAR
 SG_ LAT_DIST : 31|8@0+ (0.1,-12.7) [-12.7|12.7] "m" XXX
 SG_ VALID : 39|1@0+ (1,0) [0|1] "" XXX

BO_ 80 RADAR_TRACK_50_B: 8 RADAR
 SG_ LONG_DIST : 7|16@0+ (0.001,0) [0|65.535] "m" XXX
 SG_ REL_SPEED : 32|8@0+ (0.01,0) [0|2.55] "m/s" XXX

BO_ 33 RADAR_TRACK_21_A: 8 RADAR
 SG_ LAT_DIST : 31|8@0+ (0.1,-12.7) [-12.7|12.7] "m" XXX
 SG_ VALID : 39|1@0+ (1,0) [0|1] "" XXX

BO_ 81 RADAR_TRACK_51_B: 8 RADAR
 SG_ LONG_DIST : 7|16@0+ (0.001,0) [0|65.535] "m" XXX
 SG_ REL_SPEED : 32|8@0+ (0.01,0) [0|2.55] "m/s" XXX

BO_ 34 RADAR_TRACK_22_A: 8 RADAR
 SG_ LAT_DIST : 31|8@0+ (0.1,-12.7) [-12.7|12.7] "m" XXX
 SG_ VALID : 39|1@0+ (1,0) [0|1] "" XXX

BO_ 82 RADAR_TRACK_52_B: 8 RADAR
 SG_ LONG_DIST : 7|16@0+ (0.001,0) [0|65.535] "m" XXX
 SG_ REL_SPEED : 32|8@0+ (0.01,0) [0|2.55] "m/s" XXX

BO_ 35 RADAR_TRACK_23_A: 8 RADAR
 SG_ LAT_DIST : 31|8@0+ (0.1,-12.7) [-12.7|12.7] "m" XXX
 SG_ VALID : 39|1@0+ (1,0) [0|1] "" XXX

BO_ 83 RADAR_TRACK_53_B: 8 RADAR
 SG_ LONG_DIST : 7|16@0+ (0.001,0) [0|65.535] "m" XXX
 SG_ REL_SPEED : 32|8@0+ (0.01,0) [0|2.55] "m/s" XXX

BO_ 36 RADAR_TRACK_24_A: 8 RADAR
 SG_ LAT_DIST : 31|8@0+ (0.1,-12.7) [-12.7|12.7] "m" XXX
 SG_ VALID : 39|1@0+ (1,0) [0|1] "" XXX

BO_ 84 RADAR_TRACK_54_B: 8 RADAR
 SG_ LONG_DIST : 7|16@0+ (0.001,0) [0|65.535] "m" XXX
 SG_ REL_SPEED : 32|8@0+ (0.01,0) [0|2.55] "m/s" XXX

BO_ 37 RADAR_TRACK_25_A: 8 RADAR
 SG_ LAT_DIST : 31|8@0+ (0.1,-12.7) [-12.7|12.7] "m" XXX
 SG_ VALID : 39|1@0+ (1,0) [0|1] "" XXX

BO_ 85 RADAR_TRACK_55_B: 8 RADAR
 SG_ LONG_DIST : 7|16@0+ (0.001,0) [0|65.535] "m" XXX
 SG_ REL_SPEED : 32|8@0+ (0.01,0) [0|2.55] "m/s" XXX

BO_ 38 RADAR_TRACK_26_A: 8 RADAR
 SG_ LAT_DIST : 31|8@0+ (0.1,-12.7) [-12.7|12.7] "m" XXX
 SG_ VALID : 39|1@0+ (1,0) [0|1] "" XXX

BO_ 86 RADAR_TRACK_56_B: 8 RADAR
 SG_ LONG_DIST : 7|16@0+ (0.001,0) [0|65.535] "m" XXX
 SG_ REL_SPEED : 32|8@0+ (0.01,0) [0|2.55] "m/s" XXX

BO_ 39 RADAR_TRACK_27_A: 8 RADAR
 SG_ LAT_DIST : 31|8@0+ (0.1,-12.7) [-12.7|12.7] "m" XXX
 SG_ VALID : 39|1@0+ (1,0) [0|1] "" XXX

BO_ 87 RADAR_TRACK_57_B: 8 RADAR
 SG_ LONG_DIST : 7|16@0+ (0.001,0) [0|65.535] "m" XXX
 SG_ REL_SPEED : 32|8@0+ (0.01,0) [0|2.55] "m/s" XXX

BO_ 40 RADAR_TRACK_28_A: 8 RADAR
 SG_ LAT_DIST : 31|8@0+ (0.1,-12.7) [-12.7|12.7] "m" XXX
 SG_ VALID : 39|1@0+ (1,0) [0|1] "" XXX

BO_ 88 RADAR_TRACK_58_B: 8 RADAR
 SG_ LONG_DIST : 7|16@0+ (0.001,0) [0|65.535] "m" XXX
 SG_ REL_SPEED : 32|8@0+ (0.01,0) [0|2.55] "m/s" XXX

BO_ 41 RADAR_TRACK_29_A: 8 RADAR
 SG_ LAT_DIST : 31|8@0+ (0.1,-12.7) [-12.7|12.7] "m" XXX
 SG_ VALID : 39|1@0+ (1,0) [0|1] "" XXX

BO_ 89 RADAR_TRACK_59_B: 8 RADAR
 SG_ LONG_DIST : 7|16@0+ (0.001,0) [0|65.535] "m" XXX
 SG_ REL_SPEED : 32|8@0+ (0.01,0) [0|2.55] "m/s" XXX

BO_ 42 RADAR_TRACK_2a_A: 8 RADAR
 SG_ LAT_DIST : 31|8@0+ (0.1,-12.7) [-12.7|12.7] "m" XXX
 SG_ VALID : 39|1@0+ (1,0) [0|1] "" XXX

BO_ 90 RADAR_TRACK_5a_B: 8 RADAR
 SG_ LONG_DIST : 7|16@0+ (0.001,0) [0|65.535] "m" XXX
 SG_ REL_SPEED : 32|8@0+ (0.01,0) [0|2.55] "m/s" XXX

BO_ 43 RADAR_TRACK_2b_A: 8 RADAR
 SG_ LAT_DIST : 31|8@0+ (0.1,-12.7) [-12.7|12.7] "m" XXX
 SG_ VALID : 39|1@0+ (1,0) [0|1] "" XXX

BO_ 91 RADAR_TRACK_5b_B: 8 RADAR
 SG_ LONG_DIST : 7|16@0+ (0.001,0) [0|65.535] "m" XXX
 SG_ REL_SPEED : 32|8@0+ (0.01,0) [0|2.55] "m/s" XXX

BO_ 44 RADAR_TRACK_2c_A: 8 RADAR
 SG_ LAT_DIST : 31|8@0+ (0.1,-12.7) [-12.7|12.7] "m" XXX
 SG_ VALID : 39|1@0+ (1,0) [0|1] "" XXX

BO_ 92 RADAR_TRACK_5c_B: 8 RADAR
 SG_ LONG_DIST : 7|16@0+ (0.001,0) [0|65.535] "m" XXX
 SG_ REL_SPEED : 32|8@0+ (0.01,0) [0|2.55] "m/s" XXX

BO_ 45 RADAR_TRACK_2d_A: 8 RADAR
 SG_ LAT_DIST : 31|8@0+ (0.1,-12.7) [-12.7|12.7] "m" XXX
 SG_ VALID : 39|1@0+ (1,0) [0|1] "" XXX

BO_ 93 RADAR_TRACK_5d_B: 8 RADAR
 SG_ LONG_DIST : 7|16@0+ (0.001,0) [0|65.535] "m" XXX
 SG_ REL_SPEED : 32|8@0+ (0.01,0) [0|2.55] "m/s" XXX

BO_ 46 RADAR_TRACK_2e_A: 8 RADAR
 SG_ LAT_DIST : 31|8@0+ (0.1,-12.7) [-12.7|12.7] "m" XXX
 SG_ VALID : 39|1@0+ (1,0) [0|1] "" XXX

BO_ 94 RADAR_TRACK_5e_B: 8 RADAR
 SG_ LONG_DIST : 7|16@0+ (0.001,0) [0|65.535] "m" XXX
 SG_ REL_SPEED : 32|8@0+ (0.01,0) [0|2.55] "m/s" XXX

BO_ 47 RADAR_TRACK_2f_A: 8 RADAR
 SG_ LAT_DIST : 31|8@0+ (0.1,-12.7) [-12.7|12.7] "m" XXX
 SG_ VALID : 39|1@0+ (1,0) [0|1] "" XXX

BO_ 95 RADAR_TRACK_5f_B: 8 RADAR
 SG_ LONG_DIST : 7|16@0+ (0.001,0) [0|65.535] "m" XXX
 SG_ REL_SPEED : 32|8@0+ (0.01,0) [0|2.55] "m/s" XXX

BO_ 48 RADAR_TRACK_30_A: 8 RADAR
 SG_ LAT_DIST : 31|8@0+ (0.1,-12.7) [-12.7|12.7] "m" XXX
 SG_ VALID : 39|1@0+ (1,0) [0|1] "" XXX

BO_ 96 RADAR_TRACK_60_B: 8 RADAR
 SG_ LONG_DIST : 7|16@0+ (0.001,0) [0|65.535] "m" XXX
 SG_ REL_SPEED : 32|8@0+ (0.01,0) [0|2.55] "m/s" XXX

BO_ 49 RADAR_TRACK_31_A: 8 RADAR
 SG_ LAT_DIST : 31|8@0+ (0.1,-12.7) [-12.7|12.7] "m" XXX
 SG_ VALID : 39|1@0+ (1,0) [0|1] "" XXX

BO_ 97 RADAR_TRACK_61_B: 8 RADAR
 SG_ LONG_DIST : 7|16@0+ (0.001,0) [0|65.535] "m" XXX
 SG_ REL_SPEED : 32|8@0+ (0.01,0) [0|2.55] "m/s" XXX

BO_ 50 RADAR_TRACK_32_A: 8 RADAR
 SG_ LAT_DIST : 31|8@0+ (0.1,-12.7) [-12.7|12.7] "m" XXX
 SG_ VALID : 39|1@0+ (1,0) [0|1] "" XXX

BO_ 98 RADAR_TRACK_62_B: 8 RADAR
 SG_ LONG_DIST : 7|16@0+ (0.001,0) [0|65.535] "m" XXX
 SG_ REL_SPEED : 32|8@0+ (0.01,0) [0|2.55] "m/s" XXX

BO_ 51 RADAR_TRACK_33_A: 8 RADAR
 SG_ LAT_DIST : 31|8@0+ (0.1,-12.7) [-12.7|12.7] "m" XXX
 SG_ VALID : 39|1@0+ (1,0) [0|1] "" XXX

BO_ 99 RADAR_TRACK_63_B: 8 RADAR
 SG_ LONG_DIST : 7|16@0+ (0.001,0) [0|65.535] "m" XXX
 SG_ REL_SPEED : 32|8@0+ (0.01,0) [0|2.55] "m/s" XXX

BO_ 52 RADAR_TRACK_34_A: 8 RADAR
 SG_ LAT_DIST : 31|8@0+ (0.1,-12.7) [-12.7|12.7] "m" XXX
 SG_ VALID : 39|1@0+ (1,0) [0|1] "" XXX

BO_ 100 RADAR_TRACK_64_B: 8 RADAR
 SG_ LONG_DIST : 7|16@0+ (0.001,0) [0|65.535] "m" XXX
 SG_ REL_SPEED : 32|8@0+ (0.01,0) [0|2.55] "m/s" XXX

BO_ 53 RADAR_TRACK_35_A: 8 RADAR
 SG_ LAT_DIST : 31|8@0+ (0.1,-12.7) [-12.7|12.7] "m" XXX
 SG_ VALID : 39|1@0+ (1,0) [0|1] "" XXX

BO_ 101 RADAR_TRACK_65_B: 8 RADAR
 SG_ LONG_DIST : 7|16@0+ (0.001,0) [0|65.535] "m" XXX
 SG_ REL_SPEED : 32|8@0+ (0.01,0) [0|2.55] "m/s" XXX

BO_ 54 RADAR_TRACK_36_A: 8 RADAR
 SG_ LAT_DIST : 31|8@0+ (0.1,-12.7) [-12.7|12.7] "m" XXX
 SG_ VALID : 39|1@0+ (1,0) [0|1] "" XXX

BO_ 102 RADAR_TRACK_66_B: 8 RADAR
 SG_ LONG_DIST : 7|16@0+ (0.001,0) [0|65.535] "m" XXX
 SG_ REL_SPEED : 32|8@0+ (0.01,0) [0|2.55] "m/s" XXX

BO_ 55 RADAR_TRACK_37_A: 8 RADAR
 SG_ LAT_DIST : 31|8@0+ (0.1,-12.7) [-12.7|12.7] "m" XXX
 SG_ VALID : 39|1@0+ (1,0) [0|1] "" XXX

BO_ 103 RADAR_TRACK_67_B: 8 RADAR
 SG_ LONG_DIST : 7|16@0+ (0.001,0) [0|65.535] "m" XXX
 SG_ REL_SPEED : 32|8@0+ (0.01,0) [0|2.55] "m/s" XXX

BO_ 56 RADAR_TRACK_38_A: 8 RADAR
 SG_ LAT_DIST : 31|8@0+ (0.1,-12.7) [-12.7|12.7] "m" XXX
 SG_ VALID : 39|1@0+ (1,0) [0|1] "" XXX

BO_ 104 RADAR_TRACK_68_B: 8 RADAR
 SG_ LONG_DIST : 7|16@0+ (0.001,0) [0|65.535] "m" XXX
 SG_ REL_SPEED : 32|8@0+ (0.01,0) [0|2.55] "m/s" XXX

BO_ 57 RADAR_TRACK_39_A: 8 RADAR
 SG_ LAT_DIST : 31|8@0+ (0.1,-12.7) [-12.7|12.7] "m" XXX
 SG_ VALID : 39|1@0+ (1,0) [0|1] "" XXX

BO_ 105 RADAR_TRACK_69_B: 8 RADAR
 SG_ LONG_DIST : 7|16@0+ (0.001,0) [0|65.535] "m" XXX
 SG_ REL_SPEED : 32|8@0+ (0.01,0) [0|2.55] "m/s" XXX

BO_ 58 RADAR_TRACK_3a_A: 8 RADAR
 SG_ LAT_DIST : 31|8@0+ (0.1,-12.7) [-12.7|12.7] "m" XXX
 SG_ VALID : 39|1@0+ (1,0) [0|1] "" XXX

BO_ 106 RADAR_TRACK_6a_B: 8 RADAR
 SG_ LONG_DIST : 7|16@0+ (0.001,0) [0|65.535] "m" XXX
 SG_ REL_SPEED : 32|8@0+ (0.01,0) [0|2.55] "m/s" XXX

BO_ 59 RADAR_TRACK_3b_A: 8 RADAR
 SG_ LAT_DIST : 31|8@0+ (0.1,-12.7) [-12.7|12.7] "m" XXX
 SG_ VALID : 39|1@0+ (1,0) [0|1] "" XXX

BO_ 107 RADAR_TRACK_6b_B: 8 RADAR
 SG_ LONG_DIST : 7|16@0+ (0.001,0) [0|65.535] "m" XXX
 SG_ REL_SPEED : 32|8@0+ (0.01,0) [0|2.55] "m/s" XXX

BO_ 60 RADAR_TRACK_3c_A: 8 RADAR
 SG_ LAT_DIST : 31|8@0+ (0.1,-12.7) [-12.7|12.7] "m" XXX
 SG_ VALID : 39|1@0+ (1,0) [0|1] "" XXX

BO_ 108 RADAR_TRACK_6c_B: 8 RADAR
 SG_ LONG_DIST : 7|16@0+ (0.001,0) [0|65.535] "m" XXX
 SG_ REL_SPEED : 32|8@0+ (0.01,0) [0|2.55] "m/s" XXX

BO_ 61 RADAR_TRACK_3d_A: 8 RADAR
 SG_ LAT_DIST : 31|8@0+ (0.1,-12.7) [-12.7|12.7] "m" XXX
 SG_ VALID : 39|1@0+ (1,0) [0|1] "" XXX

BO_ 109 RADAR_TRACK_6d_B: 8 RADAR
 SG_ LONG_DIST : 7|16@0+ (0.001,0) [0|65.535] "m" XXX
 SG_ REL_SPEED : 32|8@0+ (0.01,0) [0|2.55] "m/s" XXX

BO_ 62 RADAR_TRACK_3e_A: 8 RADAR
 SG_ LAT_DIST : 31|8@0+ (0.1,-12.7) [-12.7|12.7] "m" XXX
 SG_ VALID : 39|1@0+ (1,0) [0|1] "" XXX

BO_ 110 RADAR_TRACK_6e_B: 8 RADAR
 SG_ LONG_DIST : 7|16@0+ (0.001,0) [0|65.535] "m" XXX
 SG_ REL_SPEED : 32|8@0+ (0.01,0) [0|2.55] "m/s" XXX

BO_ 63 RADAR_TRACK_3f_A: 8 RADAR
 SG_ LAT_DIST : 31|8@0+ (0.1,-12.7) [-12.7|12.7] "m" XXX
 SG_ VALID : 39|1@0+ (1,0) [0|1] "" XXX

BO_ 111 RADAR_TRACK_6f_B: 8 RADAR
 SG_ LONG_DIST : 7|16@0+ (0.001,0) [0|65.535] "m" XXX
 SG_ REL_SPEED : 32|8@0+ (0.01,0) [0|2.55] "m/s" XXX

BO_ 64 RADAR_TRACK_40_A: 8 RADAR
 SG_ LAT_DIST : 31|8@0+ (0.1,-12.7) [-12.7|12.7] "m" XXX
 SG_ VALID : 39|1@0+ (1,0) [0|1] "" XXX

BO_ 112 RADAR_TRACK_70_B: 8 RADAR
 SG_ LONG_DIST : 7|16@0+ (0.001,0) [0|65.535] "m" XXX
 SG_ REL_SPEED : 32|8@0+ (0.01,0) [0|2.55] "m/s" XXX

BO_ 65 RADAR_TRACK_41_A: 8 RADAR
 SG_ LAT_DIST : 31|8@0+ (0.1,-12.7) [-12.7|12.7] "m" XXX
 SG_ VALID : 39|1@0+ (1,0) [0|1] "" XXX

BO_ 113 RADAR_TRACK_71_B: 8 RADAR
 SG_ LONG_DIST : 7|16@0+ (0.001,0) [0|65.535] "m" XXX
 SG_ REL_SPEED : 32|8@0+ (0.01,0) [0|2.55] "m/s" XXX

BO_ 66 RADAR_TRACK_42_A: 8 RADAR
 SG_ LAT_DIST : 31|8@0+ (0.1,-12.7) [-12.7|12.7] "m" XXX
 SG_ VALID : 39|1@0+ (1,0) [0|1] "" XXX

BO_ 114 RADAR_TRACK_72_B: 8 RADAR
 SG_ LONG_DIST : 7|16@0+ (0.001,0) [0|65.535] "m" XXX
 SG_ REL_SPEED : 32|8@0+ (0.01,0) [0|2.55] "m/s" XXX

BO_ 67 RADAR_TRACK_43_A: 8 RADAR
 SG_ LAT_DIST : 31|8@0+ (0.1,-12.7) [-12.7|12.7] "m" XXX
 SG_ VALID : 39|1@0+ (1,0) [0|1] "" XXX

BO_ 115 RADAR_TRACK_73_B: 8 RADAR
 SG_ LONG_DIST : 7|16@0+ (0.001,0) [0|65.535] "m" XXX
 SG_ REL_SPEED : 32|8@0+ (0.01,0) [0|2.55] "m/s" XXX

BO_ 68 RADAR_TRACK_44_A: 8 RADAR
 SG_ LAT_DIST : 31|8@0+ (0.1,-12.7) [-12.7|12.7] "m" XXX
 SG_ VALID : 39|1@0+ (1,0) [0|1] "" XXX

BO_ 116 RADAR_TRACK_74_B: 8 RADAR
 SG_ LONG_DIST : 7|16@0+ (0.001,0) [0|65.535] "m" XXX
 SG_ REL_SPEED : 32|8@0+ (0.01,0) [0|2.55] "m/s" XXX

BO_ 69 RADAR_TRACK_45_A: 8 RADAR
 SG_ LAT_DIST : 31|8@0+ (0.1,-12.7) [-12.7|12.7] "m" XXX
 SG_ VALID : 39|1@0+ (1,0) [0|1] "" XXX

BO_ 117 RADAR_TRACK_75_B: 8 RADAR
 SG_ LONG_DIST : 7|16@0+ (0.001,0) [0|65.535] "m" XXX
 SG_ REL_SPEED : 32|8@0+ (0.01,0) [0|2.55] "m/s" XXX

BO_ 70 RADAR_TRACK_46_A: 8 RADAR
 SG_ LAT_DIST : 31|8@0+ (0.1,-12.7) [-12.7|12.7] "m" XXX
 SG_ VALID : 39|1@0+ (1,0) [0|1] "" XXX

BO_ 118 RADAR_TRACK_76_B: 8 RADAR
 SG_ LONG_DIST : 7|16@0+ (0.001,0) [0|65.535] "m" XXX
 SG_ REL_SPEED : 32|8@0+ (0.01,0) [0|2.55] "m/s" XXX

BO_ 71 RADAR_TRACK_47_A: 8 RADAR
 SG_ LAT_DIST : 31|8@0+ (0.1,-12.7) [-12.7|12.7] "m" XXX
 SG_ VALID : 39|1@0+ (1,0) [0|1] "" XXX

BO_ 119 RADAR_TRACK_77_B: 8 RADAR
 SG_ LONG_DIST : 7|16@0+ (0.001,0) [0|65.535] "m" XXX
 SG_ REL_SPEED : 32|8@0+ (0.01,0) [0|2.55] "m/s" XXX
